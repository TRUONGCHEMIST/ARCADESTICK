#include <behaviors.dtsi>
#include <dt-bindings/zmk/keys.h>
#include <dt-bindings/zmk/bt.h>

/ {
    keymap {
        compatible = "zmk,keymap";

        default_layer {
            bindings = <
                &bt BT_CLR_ALL      /* P0.06 */
                &kp F10      /* P0.08 */
                &kp A        /* P0.17 */
                &kp D       /* P0.20 */

                &kp S       /* P0.22 */
                &kp W         /* P0.24 */
                &kp U       /* P1.00 */
                &kp I       /* P0.11 */

                &kp J       /* P1.04 */
                &kp K       /* P1.06 */
                &kp LEFT       /* P0.31 */
                &kp RIGHT       /* P0.29 */

                &kp DOWN   /* P0.02 */
                &kp UP     /* P1.15 */
                &kp KP_N4   /* P1.13 */
                &kp KP_N5     /* P1.11 */

                &kp N1      /* P1.01 */
                &kp N2      /* P1.02 */
                &kp N3      /* P1.07 */
                &kp KP_N2      /* P0.09 */
                &kp KP_N1      /* P0.10 */
            >;
        };
    };
};
